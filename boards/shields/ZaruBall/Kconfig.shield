## boards/shields/ZaruBall/Kconfig.shield
```kconfig
#No whitespace after the comma or in your part name!
config SHIELD_ZARUBALL_LEFT
	def_bool $(shields_list_contains,ZaruBall_left)

config SHIELD_ZARUBALL_RIGHT
	def_bool $(shields_list_contains,ZaruBall_right)

config PMW3610_MOVEMENT_THRESHOLD
    int "Movement threshold for PMW3610"
    default 80
    help
      Threshold below which movement will be ignored by the PMW3610 driver.
```
